# GD32M53x register map
File version: 1.0
GD32M53x ARM 32-bit Cortex-M33 Microcontroller based device
CPU: CM33 r2p1, little endian, MPU, FPU, DSP, 4 interrupt priority bits
Registers are 32-bit, read-write, reset 0x0 unless marked. A register's access mark holds for its fields unless they carry their own. Offsets are from the block's base; lines under a group give offsets from that group; [hi:lo] are bit positions; {n}, {i} and the like mark numbered series; 'fields as' and 'values as' point back to an identical list; <NAME> marks a mode.

## Memory map
0x40000000 CPTIMER0 size 0x400
0x40000400 CPTIMER1 size 0x400
0x40002C00 WWDGT size 0x400 — Window watchdog timer
0x40003000 FWDGT size 0x400 — free watchdog timer
0x40004C00 UART0 size 0x400 — Universal synchronous asynchronous receiver transmitter
0x40005000 UART1 size 0x400
0x40005400 I2C size 0x400 — Inter integrated circuit
0x40007000 PMU size 0x400 — Power management unit
0x40007400 DAC size 0x400 — Digital-to-analog converter
0x40007800 UART2 size 0x400
0x40007C00 UART3 size 0x400
0x4000C800 CFMU size 0x400 — Clock frequency measurement unit
0x4000E000 CPTIMERW size 0x400
0x40010000 SYSCFG size 0x400 — System and memory architectur
0x40010400 EXTI size 0x400 — External interrupt/event controller
0x40012000 ADC0 size 0x400 — Analog-to-digital converter
0x40012400 ADC2 size 0x400 — Analog to digital converter
0x40012C00 TIMER0 size 0x400 — Advanced timer
0x40013000 SPI size 0x400 — Serial peripheral interface
0x40013400 TIMER7 size 0x400
0x40014000 TIMER1 size 0x400 — General level 0 timer
0x40014400 TIMER2 size 0x400
0x40016000 GPTIMER0 size 0x100 — General purpose timer
0x40016100 GPTIMER1 size 0x100
0x40017C00 CMP size 0x400 — Comparator
0x40018400 EVIC size 0x400 — Event interconnection unit
0x4001A000 CAN size 0x400 — Controller area network
0x40020000 DMA0 size 0x400 — DMA controller
0x40020400 DMA1 size 0x400 — DMA controller
0x40020800 DMAMUX size 0x400 — DMAMUX controller
0x40021000 RCU size 0x400 — Reset and clock unit
0x40022000 FMC size 0x400 — Flash memory controller
0x40023000 CRC size 0x400 — cyclic redundancy check calculation unit
0x48000000 GPIOA size 0x400 — General-purpose I/Os
0x48000400 GPIOB size 0x400
0x48000800 GPIOC size 0x400
0x48000C00 GPIOD size 0x400
0x48001000 GPIOE size 0x400
0x48001400 GPIOF size 0x400
0x48001800 GPIOG size 0x400
0x48004000 GPION size 0x400 — General-purpose I/Os
0x48004400 POC size 0x400 — Port Output Controller
0x48004800 GTOC size 0x400 — GPTIMER Output Controller
0x48024000 SVPWM size 0x400 — Space Vector Pulse Width Modulation
0x48024400 TMU size 0x400 — Trigonometric Math Unit
0xE0044000 DBG size 0x400 — Debug support

## Interrupts
0 WWDGT
1 LVD1 (EXTI)
2 LVD2 (EXTI)
4 FMC
5 RCU
6 EXTI_Line0 (EXTI)
7 EXTI_Line1 (EXTI)
8 EXTI_Line2 (EXTI)
9 EXTI_Line3 (EXTI)
10 EXTI_Line4 (EXTI)
11 DMA0_Channel0 (DMA0)
12 DMA0_Channel1 (DMA0)
13 DMA0_Channel2 (DMA0)
14 DMA0_Channel3 (DMA0)
15 DMA0_Channel4 (DMA0)
16 DMA0_Channel5 (DMA0)
18 ADC0 — ADC0 global interrupt
19 CAN_TX (CAN)
20 CAN_RX0 (CAN)
21 CAN_RX1 (CAN)
22 CAN_EWMC (CAN)
23 EXTI_line9_5 (EXTI)
24 TIMER0_BRK (TIMER0)
25 TIMER0_UP (TIMER0)
26 TIMER0_TRG_CM (TIMER0)
27 TIMER0_CC (TIMER0)
28 TIMER1 — TIMER1 global interrupt
29 TIMER2 — TIMER2 global interrupt
30 GPTIMER0 — GPTIMER0 global interrupt
31 I2C_EV (I2C)
32 I2C_ER (I2C)
35 SPI
37 UART0
38 UART1
40 EXTI_line15_10 (EXTI)
43 TIMER7_BRK (TIMER7)
44 TIMER7_UP (TIMER7)
45 TIMER7_TR_CM (TIMER7)
46 TIMER7_CC (TIMER7)
47 TMU — TMU interrupt
50 GPTIMER1 — GPTIMER1 global interrupt
52 UART2
53 UART3
54 CPTIMER0
55 CPTIMER1
56 DMA1_Channel0 (DMA1)
57 DMA1_Channel1 (DMA1)
58 DMA1_Channel2 (DMA1)
59 DMA1_Channel3 (DMA1)
60 DMA1_Channel4 (DMA1)
61 DMA1_Channel5 (DMA1)
62 DMA_MUX (DMAMUX)
63 CPTIMERW
65 CFMU
66 I2C_WAKEUP_FROM_EXTI_Line23 (EXTI)
67 FWDGT_FROM_EXTI_Line22 (EXTI)
70 CMP0 (CMP)
71 CMP1 (CMP)
72 CMP2 (CMP)
73 CMP3 (CMP)
75 ADC2 — ADC2 global interrupt
77 POC
78 EVIC
79 GTOC0 (GTOC)
80 GTOC1 (GTOC)
81 GTOC2 (GTOC)
82 GTOC3 (GTOC)
85 CMP0_FROM_EXTI (CMP)
86 CMP1_FROM_EXTI (CMP)
87 CMP2_FROM_EXTI (CMP)
88 CMP3_FROM_EXTI (CMP)
92 SRAM_ECC (SYSCFG)
